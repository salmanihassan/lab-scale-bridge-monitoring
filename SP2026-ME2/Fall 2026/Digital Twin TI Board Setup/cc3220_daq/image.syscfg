/**
 * Development-mode CC3220SF programming-image manifest for the diagnostic.
 * The MCU binary is supplied to SLImageCreator at image-creation time; do not
 * add credentials, service packs, or network configuration in this first test.
 *
 * @cliArgs --device CC3220SF --package Default --part Default --ccxxImageMode
 */

const General     = scripting.addModule("/ti/drivers/net/imagecreator/new_design/Device/General");
const Ota         = scripting.addModule("/ti/drivers/net/imagecreator/new_design/Device/Ota");
const Network     = scripting.addModule("/ti/drivers/net/imagecreator/new_design/NetworkServices/Network");
const CertStore   = scripting.addModule("/ti/drivers/net/imagecreator/new_design/UserFiles/CertStore");
const MCUImage    = scripting.addModule("/ti/drivers/net/imagecreator/new_design/UserFiles/MCUImage");
const ServicePack = scripting.addModule("/ti/drivers/net/imagecreator/new_design/UserFiles/ServicePack");
const fileTree    = scripting.addModule("/ti/drivers/net/imagecreator/new_design/UserFiles/fileTree");
const fileTree1   = fileTree.addInstance();
const Mac         = scripting.addModule("/ti/drivers/net/imagecreator/new_design/WiFi/Mac");
const Radio       = scripting.addModule("/ti/drivers/net/imagecreator/new_design/WiFi/Radio");

/* Keep the initial device image in development mode and provide no user
 * files beyond the SDK-required placeholder CA certificate. */
General.ModeSelect = "development";
fileTree.rootDirCfg = "userFiles";
fileTree1.$name = "ti_drivers_net_imagecreator_new_design_UserFiles_fileTree0";
fileTree1.filePathCfg = scripting.forceWrite("dummy-root-ca-cert");
