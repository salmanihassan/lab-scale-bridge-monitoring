/**
 * @cliArgs --board "/ti/boards/CC3220SF_LAUNCHXL" --rtos "freertos" --product "simplelink_cc32xx_sdk@7.10.00.13"
 * @versions {"tool":"1.12.0+2406"}
 */

/**
 * Import the modules used in this configuration.
 */
const FreeRTOS = scripting.addModule("/freertos/FreeRTOS");
const Crypto   = scripting.addModule("/ti/drivers/Crypto", {}, false);
const Crypto1  = Crypto.addInstance();
const I2C      = scripting.addModule("/ti/drivers/I2C");
const I2C1     = I2C.addInstance();
const UART2    = scripting.addModule("/ti/drivers/UART2", {}, false);
const UART21   = UART2.addInstance();
const Settings = scripting.addModule("/ti/posix/freertos/Settings");

/**
 * Write custom configuration values to the imported modules.
 */
Crypto1.$name = "CONFIG_Crypto_0";

/* ADXL345 accelerometer: LaunchPad I2C = SCL on P01 (header 9), SDA on P02 (header 10).
 * The two PWM instances that used header 9 and 10 (CONFIG_PWM_0 motor, CONFIG_PWM_1 LED) were removed. */
I2C1.$name     = "CONFIG_I2C_0";
I2C1.$hardware = system.deviceData.board.components.LP_I2C;

const Power          = scripting.addModule("/ti/drivers/Power", {}, false);
Power.parkPins.$name = "ti_drivers_power_PowerCC32XXPins0";

UART21.$name     = "CONFIG_UART2_0";
UART21.$hardware = system.deviceData.board.components.XDS110UART;

/**
 * Pinmux solution for unlocked pins/peripherals. This ensures that minor changes to the automatic solver in a future
 * version of the tool will not impact the pinmux you originally saw.  These lines can be completely deleted in order to
 * re-solve from scratch.
 */
UART21.uart.$suggestSolution              = "UART0";
UART21.uart.txPin.$suggestSolution        = "ball.55";
UART21.uart.txDmaChannel.$suggestSolution = "UDMA_CH9";
UART21.uart.rxPin.$suggestSolution        = "ball.57";
UART21.uart.rxDmaChannel.$suggestSolution = "UDMA_CH8";
