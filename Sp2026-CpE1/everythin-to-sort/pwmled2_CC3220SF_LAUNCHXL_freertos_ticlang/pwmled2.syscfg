/**
 * @cliArgs --board "/ti/boards/CC3220SF_LAUNCHXL" --rtos "freertos" --product "simplelink_cc32xx_sdk@7.10.00.13"
 * @versions {"tool":"1.12.0+2406"}
 */

/**
 * Import the modules used in this configuration.
 */
const FreeRTOS = scripting.addModule("/freertos/FreeRTOS");
const Crypto   = scripting.addModule("/ti/drivers/Crypto", {}, false);
const Crypto1  = Crypto.addInstance();
const PWM      = scripting.addModule("/ti/drivers/PWM");
const PWM1     = PWM.addInstance();
const PWM2     = PWM.addInstance();
const UART2    = scripting.addModule("/ti/drivers/UART2", {}, false);
const UART21   = UART2.addInstance();
const Settings = scripting.addModule("/ti/posix/freertos/Settings");

/**
 * Write custom configuration values to the imported modules.
 */
Crypto1.$name = "CONFIG_Crypto_0";

PWM1.$name     = "CONFIG_PWM_0";
PWM1.$hardware = system.deviceData.board.components.LED_YELLOW;

PWM2.$name     = "CONFIG_PWM_1";
PWM2.$hardware = system.deviceData.board.components.LED_GREEN;

const Power          = scripting.addModule("/ti/drivers/Power", {}, false);
Power.parkPins.$name = "ti_drivers_power_PowerCC32XXPins0";

UART21.$name     = "CONFIG_UART2_0";
UART21.$hardware = system.deviceData.board.components.XDS110UART;

/**
 * Pinmux solution for unlocked pins/peripherals. This ensures that minor changes to the automatic solver in a future
 * version of the tool will not impact the pinmux you originally saw.  These lines can be completely deleted in order to
 * re-solve from scratch.
 */
PWM1.timer.$suggestSolution               = "Timer3";
PWM1.timer.pwmPin.$suggestSolution        = "boosterpack.9";
PWM2.timer.$suggestSolution               = "Timer3";
PWM2.timer.pwmPin.$suggestSolution        = "boosterpack.10";
UART21.uart.$suggestSolution              = "UART0";
UART21.uart.txPin.$suggestSolution        = "ball.55";
UART21.uart.txDmaChannel.$suggestSolution = "UDMA_CH9";
UART21.uart.rxPin.$suggestSolution        = "ball.57";
UART21.uart.rxDmaChannel.$suggestSolution = "UDMA_CH8";
